## CMakeLists.txt
```
cmake_minimum_required(VERSION 3.25.0)

# Uncomment for (gdbserver) debugging
if(BOARD MATCHES "qemu_.*")
  list(APPEND QEMU_EXTRA_FLAGS -serial tcp:127.0.0.1:5678,server)
endif()

find_package(Zephyr REQUIRED HINTS $ENV{ZEPHYR_BASE})
project(dds_examples)

include(ExternalProject)
include(CMakePrintHelpers)

set(BUILD_DDSPERF_PING 0 CACHE BOOL "Build the CycloneDDS DDSPerf tool (ping mode)")
set(BUILD_DDSPERF_PONG 0 CACHE BOOL "Build the CycloneDDS DDSPerf tool (pong mode)")
set(BUILD_ROUNDTRIP_PING 0 CACHE BOOL "Build the CycloneDDS Roundtrip Ping example")
set(BUILD_ROUNDTRIP_PONG 0 CACHE BOOL "Build the CycloneDDS Roundtrip Pong example")
set(BUILD_THROUGHPUT_PUB 0 CACHE BOOL "Build the CycloneDDS Throughput Publisher example")
set(BUILD_THROUGHPUT_SUB 0 CACHE BOOL "Build the CycloneDDS Throughput Subscriber example")
set(BUILD_HELLOWORLD_PUB 0 CACHE BOOL "Build the CycloneDDS Hello World Publisher example")
set(BUILD_HELLOWORLD_SUB 0 CACHE BOOL "Build the CycloneDDS Hello World Subscriber example")

function(GENERATE_CDDS_CONF XML_FILE OUTPUT_FILE)
  message("Generate static CycloneDDS config (${XML_FILE} -> ${OUTPUT_FILE})")

  # Strip one-line comments, newlines, whitespace
  #file(READ ${XML_FILE} xmlout)
  #string(REGEX REPLACE "<!--[^\r\n]*-->" "" xmlout ${xmlout})
  #string(REGEX REPLACE "(\r?\n)+" "" xmlout ${xmlout})
  #string(REGEX REPLACE ">[ ]+<" "" xmlout ${xmlout})

  find_program(xxd xxd REQUIRED)
  execute_process(
    COMMAND ${xxd} -i
    INPUT_FILE ${XML_FILE}
    OUTPUT_VARIABLE conf_data
    OUTPUT_STRIP_TRAILING_WHITESPACE
    COMMAND_ERROR_IS_FATAL ANY)

  # Convert the string "CYCLONEDDS_URI=" to C array of bytes
  string(HEX "CYCLONEDDS_URI=" conf_prefix)
  string(REGEX MATCHALL "([A-Fa-f0-9][A-Fa-f0-9])" conf_prefix ${conf_prefix})
  list(JOIN conf_prefix ", 0x" conf_prefix)
  string(PREPEND conf_prefix "  0x")

  # Write to output file
  file(WRITE ${OUTPUT_FILE}
    "unsigned char cdds_xml_config[] = {\n"
    ${conf_prefix} ",\n"
    ${conf_data} ", 0\n"
    " };\n")
endfunction()

zephyr_get_system_include_directories_for_lang_as_string(C ext_system_includes)
zephyr_get_include_directories_for_lang_as_string(C ext_includes)
zephyr_get_compile_definitions_for_lang_as_string(C ext_defs)
zephyr_get_compile_options_for_lang_as_String(C ext_opts)
set(CDDS_CFLAGS
    "${ext_defs} -D_POSIX_C_SOURCE=200809L ${ext_system_includes} ${ext_includes} ${ext_opts}"
)

set(CDDS_LIB_DIR ${CMAKE_CURRENT_BINARY_DIR}/cyclonedds-prefix/lib)
set(CDDS_INCLUDE_DIR ${CMAKE_CURRENT_BINARY_DIR}/cyclonedds-prefix/include)

ExternalProject_Add(cyclonedds
  SOURCE_DIR ${CMAKE_CURRENT_SOURCE_DIR}/cyclonedds
  BINARY_DIR ${CMAKE_CURRENT_BINARY_DIR}/cyclonedds
  BUILD_COMMAND ${CMAKE_COMMAND} --build .
  CMAKE_ARGS
  -DBUILD_SHARED_LIBS=0 -DENABLE_SECURITY=0 -DENABLE_SSL=0 -DENABLE_SOURCE_SPECIFIC_MULTICAST=0 -DENABLE_IPV6=1 -DENABLE_SHM=0 -DWITH_ZEPHYR=1 
    -DCMAKE_TRY_COMPILE_TARGET_TYPE=STATIC_LIBRARY
    -DCMAKE_INSTALL_PREFIX=<INSTALL_DIR>
    -DCMAKE_VERBOSE_MAKEFILE=1
    -DCMAKE_C_FLAGS=${CDDS_CFLAGS}
    -DCMAKE_C_COMPILER=${CMAKE_C_COMPILER}
    -DCMAKE_SYSTEM_NAME=Generic
    -DCMAKE_BUILD_TYPE=Debug
  DEPENDS zephyr_interface
  BUILD_BYPRODUCTS ${CDDS_LIB_DIR}/libddsc.a
)
add_library(cdds_lib STATIC IMPORTED GLOBAL)
add_dependencies(cdds_lib cyclonedds)
set_target_properties(cdds_lib PROPERTIES IMPORTED_LOCATION ${CDDS_LIB_DIR}/libddsc.a)

target_include_directories(app PUBLIC ${CDDS_INCLUDE_DIR})
target_link_libraries(app PUBLIC cdds_lib)

if (BUILD_DDSPERF_PING OR BUILD_DDSPERF_PONG)
  GENERATE_CDDS_CONF("config.xml" "${CDDS_INCLUDE_DIR}/ddsperf_config.h")
  target_compile_definitions(app
    PRIVATE
    BUILD_DDSPERF_PING=${BUILD_DDSPERF_PING}
    BUILD_DDSPERF_PONG=${BUILD_DDSPERF_PONG})
  target_sources(app
    PRIVATE
    src/ddsperf_main.c
    src/ddsperf.c
    src/ddsperf_types.c src/ddsperf_types.h
    src/cputime.c src/cputime.h
    src/netload.c src/netload.h
    src/async_listener.c src/async_listener.h
  )
elseif(BUILD_ROUNDTRIP_PING OR BUILD_ROUNDTRIP_PONG)
  GENERATE_CDDS_CONF("config.xml" "${CDDS_INCLUDE_DIR}/roundtrip_config.h")
  target_compile_definitions(app
    PRIVATE
    BUILD_ROUNDTRIP_PING=${BUILD_ROUNDTRIP_PING}
    BUILD_ROUNDTRIP_PONG=${BUILD_ROUNDTRIP_PONG})
  target_sources(app
    PRIVATE
    src/roundtrip_main.c
    src/RoundTrip.c src/RoundTrip.h
    src/ping.c src/pong.c)
elseif(BUILD_THROUGHPUT_PUB OR BUILD_THROUGHPUT_SUB)
  GENERATE_CDDS_CONF("config.xml" "${CDDS_INCLUDE_DIR}/throughput_config.h")
  target_compile_definitions(app
    PRIVATE
    BUILD_THROUGHPUT_PUB=${BUILD_THROUGHPUT_PUB}
    BUILD_THROUGHPUT_SUB=${BUILD_THROUGHPUT_SUB})
  target_sources(app
    PRIVATE
    src/throughput_main.c
    src/Throughput.c src/Throughput.h
    src/subscriber.c src/publisher.c)

elseif(BUILD_HELLOWORLD_PUB OR BUILD_HELLOWORLD_SUB)
  target_compile_definitions(app
    PRIVATE
    BUILD_HELLOWORLD_PUB=${BUILD_HELLOWORLD_PUB}
    BUILD_HELLOWORLD_SUB=${BUILD_HELLOWORLD_SUB})
  target_sources(app
    PRIVATE
    src/main.c
    src/HelloWorldData.c
    src/HelloWorldData.h
  )
endif()
```

## prj.conf
```kconfig
CONFIG_NEWLIB_LIBC=y
CONFIG_NEWLIB_LIBC_NANO=n
CONFIG_MAIN_STACK_SIZE=131072

CONFIG_POSIX_API=y

# needed for CONFIG_POSIX_FS=y
# (undefined reference to _open: lib/posix/fs.c:FUNC_ALIAS(open, _open, int);
#CONFIG_FILE_SYSTEM=y 

CONFIG_THREAD_LOCAL_STORAGE=y
CONFIG_THREAD_NAME=y

CONFIG_NETWORKING=y
CONFIG_NET_IPV4=y
CONFIG_NET_IPV6=y
CONFIG_NET_SOCKETS=y
###CONFIG_NET_SOCKETS_POSIX_NAMES=y
CONFIG_DNS_RESOLVER=n

CONFIG_LOG=y
CONFIG_LOG_MODE_IMMEDIATE=y

CONFIG_ENTROPY_GENERATOR=y
CONFIG_TEST_RANDOM_GENERATOR=y
#CONFIG_KOBJECT_TEXT_AREA=4096

CONFIG_MAX_PTHREAD_COUNT=10
CONFIG_MAX_PTHREAD_MUTEX_COUNT=500
CONFIG_MAX_PTHREAD_COND_COUNT=150
CONFIG_NET_SOCKETS_POLL_MAX=6

CONFIG_IDLE_STACK_SIZE=4096
#CONFIG_ISR_STACK_SIZE=4096
CONFIG_SYSTEM_WORKQUEUE_STACK_SIZE=8192

CONFIG_NET_TX_STACK_SIZE=32768
CONFIG_NET_RX_STACK_SIZE=32768
CONFIG_NET_PKT_RX_COUNT=64
CONFIG_NET_PKT_TX_COUNT=64
CONFIG_NET_BUF_RX_COUNT=512
CONFIG_NET_BUF_TX_COUNT=256
CONFIG_NET_CONTEXT_NET_PKT_POOL=y
CONFIG_NET_MGMT_EVENT_STACK_SIZE=8192
CONFIG_NET_DEBUG_MGMT_EVENT_STACK=y
CONFIG_NET_BUF_DATA_SIZE=512


CONFIG_NET_CONFIG_SETTINGS=y
##CONFIG_NET_CONFIG_NEED_IPV6=y
##CONFIG_NET_CONFIG_MY_IPV6_ADDR="2001:db8::1"
#CONFIG_NET_CONFIG_PEER_IPV6_ADDR="2001:db8::2"
CONFIG_NET_CONFIG_NEED_IPV4=y
CONFIG_NET_CONFIG_MY_IPV4_ADDR="192.0.2.1"
#CONFIG_NET_CONFIG_PEER_IPV4_ADDR="192.0.2.2"

#CONFIG_HEAP_MEM_POOL_SIZE=32768
#CONFIG_NEWLIB_LIBC_MAX_MAPPED_REGION_SIZE=4194304
CONFIG_NET_SOCKETPAIR=y
#CONFIG_NET_IPV4_IGMP=y
#CONFIG_NET_IPV6_MLD=y
CONFIG_NET_IF_MCAST_IPV6_ADDR_COUNT=5
CONFIG_NET_IF_MCAST_IPV4_ADDR_COUNT=5

# debug sched
#CONFIG_SYSTEM_WORKQUEUE_NO_YIELD=y
CONFIG_NUM_COOP_PRIORITIES=0
CONFIG_NET_TC_RX_COUNT=0
```

## overlay-e1000.conf
```kconfig
# Overlay for experimental TCP as qemu_x86 with E1000

CONFIG_PCIE=y

#CONFIG_NET_SLIP_TAP=y
CONFIG_NET_L2_ETHERNET=y

CONFIG_NET_QEMU_ETHERNET=y
#CONFIG_NET_QEMU_SLIP=y
#CONFIG_NET_LOOPBACK=y

#CONFIG_ETHERNET_LOG_LEVEL_DBG=y
```

## boards/qemu_x86.conf
```kconfig
CONFIG_GDBSTUB=y
CONFIG_DEBUG=y
CONFIG_DEBUG_COREDUMP=y
CONFIG_DEBUG_COREDUMP_BACKEND_LOGGING=y
CONFIG_NO_OPTIMIZATIONS=y
```

## boards/s32z270dc2_rtu0_r52.conf
```kconfig
CONFIG_NET_L2_ETHERNET=y

# mcast testing
CONFIG_NET_IPV4_FRAGMENT=y
CONFIG_NET_IPV6_FRAGMENT=y
CONFIG_NET_BUF_DATA_SIZE=1024
###

CONFIG_ETH_NXP_S32_TX_RING_LEN=64
CONFIG_ETH_NXP_S32_RX_RING_LEN=64
CONFIG_ETH_NXP_S32_RX_IRQ_PACKET_THRESHOLD=8

CONFIG_ETH_NXP_S32_RX_THREAD_STACK_SIZE=8192

CONFIG_NET_IF_MCAST_IPV4_ADDR_COUNT=5
CONFIG_NET_IF_MCAST_IPV6_ADDR_COUNT=6

# For ipv4 multicast receive:
CONFIG_NET_PROMISCUOUS_MODE=y

# for net shell
CONFIG_NET_SHELL=y
CONFIG_NET_STATISTICS=y
CONFIG_NET_BUF_POOL_USAGE=y
###

#CONFIG_GDBSTUB=y
#CONFIG_DEBUG=y
#CONFIG_STACK_SENTINEL=y
#CONFIG_STACK_CANARIES=y
#CONFIG_DEBUG_COREDUMP=y
#CONFIG_DEBUG_COREDUMP_BACKEND_LOGGING=y
#CONFIG_NO_OPTIMIZATIONS=y
CONFIG_NET_LOG=y
CONFIG_NET_CORE_LOG_LEVEL_DEFAULT=y
#CONFIG_LOG_DEFAULT_LEVEL=3
```

## src/main.c
```c
#include <zephyr/kernel.h>

#include <stdio.h>
#include <stdlib.h>
#include <dds/dds.h>
#include <dds/ddsi/ddsi_config.h>
#include "HelloWorldData.h"

void init_config(struct ddsi_config *cfg)
{
  ddsi_config_init_default (cfg);
  cfg->rbuf_size = 40 * 1024;
  cfg->rmsg_chunk_size = 20 * 1024;
  //cfg->tracemask = DDS_LC_ALL;
  cfg->tracemask = DDS_LC_INFO | DDS_LC_CONFIG;
  cfg->tracefile = "stderr";
  cfg->tracefp = NULL;
  cfg->multiple_recv_threads = DDSI_BOOLDEF_FALSE;
  //cfg->max_msg_size = 1452;
  cfg->retransmit_merging = DDSI_REXMIT_MERGE_ALWAYS;
  //cfg->transport_selector = DDSI_TRANS_UDP6;
  //cfg->defaultMulticastAddressString = "239.255.0.2";

  struct ddsi_config_network_interface_listelem *ifcfg = malloc(sizeof *ifcfg);
  memset(ifcfg, 0, sizeof *ifcfg);
  ifcfg->next = NULL;
  ifcfg->cfg.prefer_multicast = true;
#if defined(CONFIG_BOARD_QEMU_X86)
  ifcfg->cfg.name = "eth0";
#elif defined(CONFIG_BOARD_S32Z270DC2_RTU0_R52)
  ifcfg->cfg.name = "ethernet@74b00000";
#endif
  cfg->network_interfaces = ifcfg;
  
#if defined(CONFIG_NET_CONFIG_PEER_IPV6_ADDR)
  if (strlen(CONFIG_NET_CONFIG_PEER_IPV6_ADDR) > 0) {
    struct ddsi_config_peer_listelem *peer = malloc(sizeof *peer);
    peer->next = NULL;
    peer->peer = CONFIG_NET_CONFIG_PEER_IPV6_ADDR;
    cfg->peers = peer;
  }
#elif defined(CONFIG_NET_CONFIG_PEER_IPV4_ADDR)
  if (strlen(CONFIG_NET_CONFIG_PEER_IPV4_ADDR) > 0)) {
    struct ddsi_config_peer_listelem *peer = malloc(sizeof *peer);
    peer->next = NULL;
    peer->peer = CONFIG_NET_CONFIG_PEER_IPV4_ADDR;
    cfg->peers = peer;
  }
#endif
}

void helloworld_publisher()
{
  dds_entity_t participant;
  dds_entity_t topic;
  dds_entity_t writer;
  dds_return_t rc;
  HelloWorldData_Msg msg;
  uint32_t status = 0;
  struct ddsi_config config;

  init_config(&config);
  dds_entity_t domain = dds_create_domain_with_rawconfig (1, &config);

  /* Create a Participant. */
  participant = dds_create_participant (1, NULL, NULL);
  if (participant < 0)
    DDS_FATAL("dds_create_participant: %s\n", dds_strretcode(-participant));

  /* Create a Topic. */
  topic = dds_create_topic (
    participant, &HelloWorldData_Msg_desc, "HelloWorldData_Msg", NULL, NULL);
  if (topic < 0)
    DDS_FATAL("dds_create_topic: %s\n", dds_strretcode(-topic));

  /* Create a Writer. */
  writer = dds_create_writer (participant, topic, NULL, NULL);
  if (writer < 0)
    DDS_FATAL("dds_create_writer: %s\n", dds_strretcode(-writer));

  printf("=== [Publisher]  Waiting for a reader to be discovered ...\n");
  fflush (stdout);

  rc = dds_set_status_mask(writer, DDS_PUBLICATION_MATCHED_STATUS);
  if (rc != DDS_RETCODE_OK)
    DDS_FATAL("dds_set_status_mask: %s\n", dds_strretcode(-rc));

  while(!(status & DDS_PUBLICATION_MATCHED_STATUS))
  {
    rc = dds_get_status_changes (writer, &status);
    if (rc != DDS_RETCODE_OK)
      DDS_FATAL("dds_get_status_changes: %s\n", dds_strretcode(-rc));

    /* Polling sleep. */
    dds_sleepfor (DDS_MSECS (20));
  }

  /* Create a message to write. */
  msg.userID = 1;
  msg.message = "Hello World";

  printf ("=== [Publisher]  Writing : ");
  printf ("Message (%"PRId32", %s)\n", msg.userID, msg.message);
  fflush (stdout);

  rc = dds_write (writer, &msg);
  if (rc != DDS_RETCODE_OK)
    DDS_FATAL("dds_write: %s\n", dds_strretcode(-rc));

  /* Deleting the participant will delete all its children recursively as well. */
  rc = dds_delete (participant);
  if (rc != DDS_RETCODE_OK)
    DDS_FATAL("dds_delete: %s\n", dds_strretcode(-rc));

  rc = dds_delete (domain);
  if (rc != DDS_RETCODE_OK)
    DDS_FATAL("dds_delete (domain): %s\n", dds_strretcode(-rc));

  //printf ("Wait for network tx\n");
  //fflush(stdout);
  //dds_sleepfor(DDS_SECS(2));
}

#define MAX_SAMPLES 1

void helloworld_subscriber()
{
  dds_entity_t participant;
  dds_entity_t topic;
  dds_entity_t reader;
  HelloWorldData_Msg *msg;
  void *samples[MAX_SAMPLES];
  dds_sample_info_t infos[MAX_SAMPLES];
  dds_return_t rc;
  dds_qos_t *qos;
  struct ddsi_config config;

  dds_set_log_mask(DDS_LC_ALL);

  init_config(&config);
  dds_entity_t domain = dds_create_domain_with_rawconfig (1, &config);
  if (domain < 0)
      DDS_FATAL("dds_create_domain_with_rawconfig: %s\n", dds_strretcode(-domain));

  /* Create a Participant. */
  participant = dds_create_participant (1, NULL, NULL);
  if (participant < 0)
    DDS_FATAL("dds_create_participant: %s\n", dds_strretcode(-participant));

  /* Create a Topic. */
  topic = dds_create_topic (
    participant, &HelloWorldData_Msg_desc, "HelloWorldData_Msg", NULL, NULL);
  if (topic < 0)
    DDS_FATAL("dds_create_topic: %s\n", dds_strretcode(-topic));

  /* Create a reliable Reader. */
  qos = dds_create_qos ();
  dds_qset_reliability (qos, DDS_RELIABILITY_RELIABLE, DDS_SECS (10));

  //printf("sleep main\n");
  //dds_sleepfor (DDS_MSECS (500));

  reader = dds_create_reader (participant, topic, qos, NULL);
  if (reader < 0)
    DDS_FATAL("dds_create_reader: %s\n", dds_strretcode(-reader));
  dds_delete_qos(qos);

  printf ("\n=== [Subscriber] Waiting for a sample ...\n");
  fflush (stdout);

  /* Initialize sample buffer, by pointing the void pointer within
   * the buffer array to a valid sample memory location. */
  samples[0] = HelloWorldData_Msg__alloc ();

  /* Poll until data has been read. */
  while (true)
  {
    /* Do the actual read.
     * The return value contains the number of read samples. */
    rc = dds_read (reader, samples, infos, MAX_SAMPLES, MAX_SAMPLES);
    if (rc < 0)
      DDS_FATAL("dds_read: %s\n", dds_strretcode(-rc));

    /* Check if we read some data and it is valid. */
    if ((rc > 0) && (infos[0].valid_data))
    {
      /* Print Message. */
      msg = (HelloWorldData_Msg*) samples[0];
      printf ("=== [Subscriber] Received : ");
      printf ("Message (%"PRId32", %s)\n", msg->userID, msg->message);
      fflush (stdout);
      break;
    }
    else
    {
      /* Polling sleep. */
      dds_sleepfor (DDS_MSECS (20));
    }
  }

  /* Free the data location. */
  HelloWorldData_Msg_free (samples[0], DDS_FREE_ALL);

  /* Deleting the participant will delete all its children recursively as well. */
  rc = dds_delete (participant);
  if (rc != DDS_RETCODE_OK)
    DDS_FATAL("dds_delete (participant): %s\n", dds_strretcode(-rc));

  rc = dds_delete (domain);
  if (rc != DDS_RETCODE_OK)
    DDS_FATAL("dds_delete (domain): %s\n", dds_strretcode(-rc));
}

void main(void)
{
    printf("CycloneDDS Hello World! %s\n", CONFIG_BOARD);
    //helloworld_publisher();
    helloworld_subscriber();
    printf("Done\n");
    return;
}
```

## src/HelloWorldData.c
```c
/****************************************************************

  Generated by Eclipse Cyclone DDS IDL to C Translator
  File name: /home/patrickm/zephyrproject/zephyr/samples/dds_hello_world/src/HelloWorldData.c
  Source: /home/patrickm/zephyrproject/zephyr/samples/dds_hello_world/cyclonedds/examples/helloworld/HelloWorldData.idl
  Cyclone DDS: V0.11.0

*****************************************************************/
#include "HelloWorldData.h"

static const uint32_t HelloWorldData_Msg_ops [] =
{
  /* Msg */
  DDS_OP_ADR | DDS_OP_FLAG_KEY | DDS_OP_FLAG_MU | DDS_OP_TYPE_4BY | DDS_OP_FLAG_SGN, offsetof (HelloWorldData_Msg, userID),
  DDS_OP_ADR | DDS_OP_TYPE_STR, offsetof (HelloWorldData_Msg, message),
  DDS_OP_RTS,
  
  /* key: userID */
  DDS_OP_KOF | 1, 0u /* order: 0 */
};

static const dds_key_descriptor_t HelloWorldData_Msg_keys[1] =
{
  { "userID", 5, 0 }
};

/* Type Information:
  [MINIMAL 6e42149eb141a0d72594c650d73c] (#deps: 0)
  [COMPLETE b1a3b1fb8b1a60516014297c3b8a] (#deps: 0)
*/
#define TYPE_INFO_CDR_HelloWorldData_Msg (unsigned char []){ \
  0x60, 0x00, 0x00, 0x00, 0x01, 0x10, 0x00, 0x40, 0x28, 0x00, 0x00, 0x00, 0x24, 0x00, 0x00, 0x00, \
  0x14, 0x00, 0x00, 0x00, 0xf1, 0x6e, 0x42, 0x14, 0x9e, 0xb1, 0x41, 0xa0, 0xd7, 0x25, 0x94, 0xc6, \
  0x50, 0xd7, 0x3c, 0x00, 0x38, 0x00, 0x00, 0x00, 0x00, 0x00, 0x00, 0x00, 0x04, 0x00, 0x00, 0x00, \
  0x00, 0x00, 0x00, 0x00, 0x02, 0x10, 0x00, 0x40, 0x28, 0x00, 0x00, 0x00, 0x24, 0x00, 0x00, 0x00, \
  0x14, 0x00, 0x00, 0x00, 0xf2, 0xb1, 0xa3, 0xb1, 0xfb, 0x8b, 0x1a, 0x60, 0x51, 0x60, 0x14, 0x29, \
  0x7c, 0x3b, 0x8a, 0x00, 0x66, 0x00, 0x00, 0x00, 0x00, 0x00, 0x00, 0x00, 0x04, 0x00, 0x00, 0x00, \
  0x00, 0x00, 0x00, 0x00\
}
#define TYPE_INFO_CDR_SZ_HelloWorldData_Msg 100u
#define TYPE_MAP_CDR_HelloWorldData_Msg (unsigned char []){ \
  0x4c, 0x00, 0x00, 0x00, 0x01, 0x00, 0x00, 0x00, 0xf1, 0x6e, 0x42, 0x14, 0x9e, 0xb1, 0x41, 0xa0, \
  0xd7, 0x25, 0x94, 0xc6, 0x50, 0xd7, 0x3c, 0x00, 0x34, 0x00, 0x00, 0x00, 0xf1, 0x51, 0x01, 0x00, \
  0x01, 0x00, 0x00, 0x00, 0x00, 0x00, 0x00, 0x00, 0x24, 0x00, 0x00, 0x00, 0x02, 0x00, 0x00, 0x00, \
  0x0b, 0x00, 0x00, 0x00, 0x00, 0x00, 0x00, 0x00, 0x31, 0x00, 0x04, 0x58, 0x5c, 0x95, 0x70, 0x00, \
  0x0c, 0x00, 0x00, 0x00, 0x01, 0x00, 0x00, 0x00, 0x01, 0x00, 0x70, 0x00, 0x78, 0xe7, 0x31, 0x02, \
  0x7a, 0x00, 0x00, 0x00, 0x01, 0x00, 0x00, 0x00, 0xf2, 0xb1, 0xa3, 0xb1, 0xfb, 0x8b, 0x1a, 0x60, \
  0x51, 0x60, 0x14, 0x29, 0x7c, 0x3b, 0x8a, 0x00, 0x62, 0x00, 0x00, 0x00, 0xf2, 0x51, 0x01, 0x00, \
  0x1c, 0x00, 0x00, 0x00, 0x00, 0x00, 0x00, 0x00, 0x14, 0x00, 0x00, 0x00, 0x48, 0x65, 0x6c, 0x6c, \
  0x6f, 0x57, 0x6f, 0x72, 0x6c, 0x64, 0x44, 0x61, 0x74, 0x61, 0x3a, 0x3a, 0x4d, 0x73, 0x67, 0x00, \
  0x3a, 0x00, 0x00, 0x00, 0x02, 0x00, 0x00, 0x00, 0x15, 0x00, 0x00, 0x00, 0x00, 0x00, 0x00, 0x00, \
  0x31, 0x00, 0x04, 0x00, 0x07, 0x00, 0x00, 0x00, 0x75, 0x73, 0x65, 0x72, 0x49, 0x44, 0x00, 0x00, \
  0x00, 0x00, 0x00, 0x00, 0x16, 0x00, 0x00, 0x00, 0x01, 0x00, 0x00, 0x00, 0x01, 0x00, 0x70, 0x00, \
  0x08, 0x00, 0x00, 0x00, 0x6d, 0x65, 0x73, 0x73, 0x61, 0x67, 0x65, 0x00, 0x00, 0x00, 0x00, 0x00, \
  0x22, 0x00, 0x00, 0x00, 0x01, 0x00, 0x00, 0x00, 0xf2, 0xb1, 0xa3, 0xb1, 0xfb, 0x8b, 0x1a, 0x60, \
  0x51, 0x60, 0x14, 0x29, 0x7c, 0x3b, 0x8a, 0xf1, 0x6e, 0x42, 0x14, 0x9e, 0xb1, 0x41, 0xa0, 0xd7, \
  0x25, 0x94, 0xc6, 0x50, 0xd7, 0x3c\
}
#define TYPE_MAP_CDR_SZ_HelloWorldData_Msg 246u
const dds_topic_descriptor_t HelloWorldData_Msg_desc =
{
  .m_size = sizeof (HelloWorldData_Msg),
  .m_align = dds_alignof (HelloWorldData_Msg),
  .m_flagset = DDS_TOPIC_FIXED_KEY | DDS_TOPIC_FIXED_KEY_XCDR2 | DDS_TOPIC_XTYPES_METADATA,
  .m_nkeys = 1u,
  .m_typename = "HelloWorldData::Msg",
  .m_keys = HelloWorldData_Msg_keys,
  .m_nops = 3,
  .m_ops = HelloWorldData_Msg_ops,
  .m_meta = "",
  .type_information = { .data = TYPE_INFO_CDR_HelloWorldData_Msg, .sz = TYPE_INFO_CDR_SZ_HelloWorldData_Msg },
  .type_mapping = { .data = TYPE_MAP_CDR_HelloWorldData_Msg, .sz = TYPE_MAP_CDR_SZ_HelloWorldData_Msg }
};
```

## src/HelloWorldData.h
```c
/****************************************************************

  Generated by Eclipse Cyclone DDS IDL to C Translator
  File name: /home/patrickm/zephyrproject/zephyr/samples/dds_hello_world/src/HelloWorldData.h
  Source: /home/patrickm/zephyrproject/zephyr/samples/dds_hello_world/cyclonedds/examples/helloworld/HelloWorldData.idl
  Cyclone DDS: V0.11.0

*****************************************************************/
#ifndef DDSC__HOME_PATRICKM_ZEPHYRPROJECT_ZEPHYR_SAMPLES_DDS_HELLO_WORLD_SRC_HELLOWORLDDATA_H
#define DDSC__HOME_PATRICKM_ZEPHYRPROJECT_ZEPHYR_SAMPLES_DDS_HELLO_WORLD_SRC_HELLOWORLDDATA_H

#include "dds/ddsc/dds_public_impl.h"

#ifdef __cplusplus
extern "C" {
#endif

typedef struct HelloWorldData_Msg
{
  int32_t userID;
  char * message;
} HelloWorldData_Msg;

extern const dds_topic_descriptor_t HelloWorldData_Msg_desc;

#define HelloWorldData_Msg__alloc() \
((HelloWorldData_Msg*) dds_alloc (sizeof (HelloWorldData_Msg)));

#define HelloWorldData_Msg_free(d,o) \
dds_sample_free ((d), &HelloWorldData_Msg_desc, (o))

#ifdef __cplusplus
}
#endif

#endif /* DDSC__HOME_PATRICKM_ZEPHYRPROJECT_ZEPHYR_SAMPLES_DDS_HELLO_WORLD_SRC_HELLOWORLDDATA_H */
```

## src/RoundTrip.c
```c
/****************************************************************

  Generated by Eclipse Cyclone DDS IDL to C Translator
  File name: /home/patrickm/zephyrproject/zephyr/samples/dds_hello_world/src/RoundTrip.c
  Source: /home/patrickm/zephyrproject/zephyr/samples/dds_hello_world/cyclonedds/examples/roundtrip/RoundTrip.idl
  Cyclone DDS: V0.11.0

*****************************************************************/
#include "RoundTrip.h"

static const uint32_t RoundTripModule_DataType_ops [] =
{
  /* DataType */
  DDS_OP_ADR | DDS_OP_TYPE_SEQ | DDS_OP_SUBTYPE_1BY, offsetof (RoundTripModule_DataType, payload),
  DDS_OP_RTS
};

/* Type Information:
  [MINIMAL 535515d9c79ca00f114126b29771] (#deps: 0)
  [COMPLETE 9c62f603b6dc77d29881277d74d3] (#deps: 0)
*/
#define TYPE_INFO_CDR_RoundTripModule_DataType (unsigned char []){ \
  0x60, 0x00, 0x00, 0x00, 0x01, 0x10, 0x00, 0x40, 0x28, 0x00, 0x00, 0x00, 0x24, 0x00, 0x00, 0x00, \
  0x14, 0x00, 0x00, 0x00, 0xf1, 0x53, 0x55, 0x15, 0xd9, 0xc7, 0x9c, 0xa0, 0x0f, 0x11, 0x41, 0x26, \
  0xb2, 0x97, 0x71, 0x00, 0x2c, 0x00, 0x00, 0x00, 0x00, 0x00, 0x00, 0x00, 0x04, 0x00, 0x00, 0x00, \
  0x00, 0x00, 0x00, 0x00, 0x02, 0x10, 0x00, 0x40, 0x28, 0x00, 0x00, 0x00, 0x24, 0x00, 0x00, 0x00, \
  0x14, 0x00, 0x00, 0x00, 0xf2, 0x9c, 0x62, 0xf6, 0x03, 0xb6, 0xdc, 0x77, 0xd2, 0x98, 0x81, 0x27, \
  0x7d, 0x74, 0xd3, 0x00, 0x56, 0x00, 0x00, 0x00, 0x00, 0x00, 0x00, 0x00, 0x04, 0x00, 0x00, 0x00, \
  0x00, 0x00, 0x00, 0x00\
}
#define TYPE_INFO_CDR_SZ_RoundTripModule_DataType 100u
#define TYPE_MAP_CDR_RoundTripModule_DataType (unsigned char []){ \
  0x40, 0x00, 0x00, 0x00, 0x01, 0x00, 0x00, 0x00, 0xf1, 0x53, 0x55, 0x15, 0xd9, 0xc7, 0x9c, 0xa0, \
  0x0f, 0x11, 0x41, 0x26, 0xb2, 0x97, 0x71, 0x00, 0x28, 0x00, 0x00, 0x00, 0xf1, 0x51, 0x01, 0x00, \
  0x01, 0x00, 0x00, 0x00, 0x00, 0x00, 0x00, 0x00, 0x18, 0x00, 0x00, 0x00, 0x01, 0x00, 0x00, 0x00, \
  0x10, 0x00, 0x00, 0x00, 0x00, 0x00, 0x00, 0x00, 0x01, 0x00, 0x80, 0xf3, 0x01, 0x00, 0x00, 0x02, \
  0x32, 0x1c, 0x3c, 0xf4, 0x6a, 0x00, 0x00, 0x00, 0x01, 0x00, 0x00, 0x00, 0xf2, 0x9c, 0x62, 0xf6, \
  0x03, 0xb6, 0xdc, 0x77, 0xd2, 0x98, 0x81, 0x27, 0x7d, 0x74, 0xd3, 0x00, 0x52, 0x00, 0x00, 0x00, \
  0xf2, 0x51, 0x01, 0x00, 0x22, 0x00, 0x00, 0x00, 0x00, 0x00, 0x00, 0x00, 0x1a, 0x00, 0x00, 0x00, \
  0x52, 0x6f, 0x75, 0x6e, 0x64, 0x54, 0x72, 0x69, 0x70, 0x4d, 0x6f, 0x64, 0x75, 0x6c, 0x65, 0x3a, \
  0x3a, 0x44, 0x61, 0x74, 0x61, 0x54, 0x79, 0x70, 0x65, 0x00, 0x00, 0x00, 0x22, 0x00, 0x00, 0x00, \
  0x01, 0x00, 0x00, 0x00, 0x1a, 0x00, 0x00, 0x00, 0x00, 0x00, 0x00, 0x00, 0x01, 0x00, 0x80, 0xf3, \
  0x01, 0x00, 0x00, 0x02, 0x08, 0x00, 0x00, 0x00, 0x70, 0x61, 0x79, 0x6c, 0x6f, 0x61, 0x64, 0x00, \
  0x00, 0x00, 0x00, 0x00, 0x22, 0x00, 0x00, 0x00, 0x01, 0x00, 0x00, 0x00, 0xf2, 0x9c, 0x62, 0xf6, \
  0x03, 0xb6, 0xdc, 0x77, 0xd2, 0x98, 0x81, 0x27, 0x7d, 0x74, 0xd3, 0xf1, 0x53, 0x55, 0x15, 0xd9, \
  0xc7, 0x9c, 0xa0, 0x0f, 0x11, 0x41, 0x26, 0xb2, 0x97, 0x71\
}
#define TYPE_MAP_CDR_SZ_RoundTripModule_DataType 218u
const dds_topic_descriptor_t RoundTripModule_DataType_desc =
{
  .m_size = sizeof (RoundTripModule_DataType),
  .m_align = dds_alignof (RoundTripModule_DataType),
  .m_flagset = DDS_TOPIC_XTYPES_METADATA,
  .m_nkeys = 0u,
  .m_typename = "RoundTripModule::DataType",
  .m_keys = NULL,
  .m_nops = 2,
  .m_ops = RoundTripModule_DataType_ops,
  .m_meta = "",
  .type_information = { .data = TYPE_INFO_CDR_RoundTripModule_DataType, .sz = TYPE_INFO_CDR_SZ_RoundTripModule_DataType },
  .type_mapping = { .data = TYPE_MAP_CDR_RoundTripModule_DataType, .sz = TYPE_MAP_CDR_SZ_RoundTripModule_DataType }
};
```

## src/RoundTrip.h
```c
/****************************************************************

  Generated by Eclipse Cyclone DDS IDL to C Translator
  File name: /home/patrickm/zephyrproject/zephyr/samples/dds_hello_world/src/RoundTrip.h
  Source: /home/patrickm/zephyrproject/zephyr/samples/dds_hello_world/cyclonedds/examples/roundtrip/RoundTrip.idl
  Cyclone DDS: V0.11.0

*****************************************************************/
#ifndef DDSC__HOME_PATRICKM_ZEPHYRPROJECT_ZEPHYR_SAMPLES_DDS_HELLO_WORLD_SRC_ROUNDTRIP_H
#define DDSC__HOME_PATRICKM_ZEPHYRPROJECT_ZEPHYR_SAMPLES_DDS_HELLO_WORLD_SRC_ROUNDTRIP_H

#include "dds/ddsc/dds_public_impl.h"

#ifdef __cplusplus
extern "C" {
#endif

#ifndef DDS_SEQUENCE_OCTET_DEFINED
#define DDS_SEQUENCE_OCTET_DEFINED
typedef struct dds_sequence_octet
{
  uint32_t _maximum;
  uint32_t _length;
  uint8_t *_buffer;
  bool _release;
} dds_sequence_octet;

#define dds_sequence_octet__alloc() \
((dds_sequence_octet*) dds_alloc (sizeof (dds_sequence_octet)));

#define dds_sequence_octet_allocbuf(l) \
((uint8_t *) dds_alloc ((l) * sizeof (uint8_t)))
#endif /* DDS_SEQUENCE_OCTET_DEFINED */

typedef struct RoundTripModule_DataType
{
  dds_sequence_octet payload;
} RoundTripModule_DataType;

extern const dds_topic_descriptor_t RoundTripModule_DataType_desc;

#define RoundTripModule_DataType__alloc() \
((RoundTripModule_DataType*) dds_alloc (sizeof (RoundTripModule_DataType)));

#define RoundTripModule_DataType_free(d,o) \
dds_sample_free ((d), &RoundTripModule_DataType_desc, (o))

#ifdef __cplusplus
}
#endif

#endif /* DDSC__HOME_PATRICKM_ZEPHYRPROJECT_ZEPHYR_SAMPLES_DDS_HELLO_WORLD_SRC_ROUNDTRIP_H */
```

## src/Throughput.c
```c
/****************************************************************

  Generated by Eclipse Cyclone DDS IDL to C Translator
  File name: /home/patrickm/zephyrproject/zephyr/samples/dds_hello_world/src/Throughput.c
  Source: /home/patrickm/zephyrproject/zephyr/samples/dds_hello_world/cyclonedds/examples/throughput/Throughput.idl
  Cyclone DDS: V0.11.0

*****************************************************************/
#include "Throughput.h"

static const uint32_t ThroughputModule_DataType_ops [] =
{
  /* DataType */
  DDS_OP_ADR | DDS_OP_TYPE_8BY, offsetof (ThroughputModule_DataType, count),
  DDS_OP_ADR | DDS_OP_TYPE_SEQ | DDS_OP_SUBTYPE_1BY, offsetof (ThroughputModule_DataType, payload),
  DDS_OP_RTS
};

/* Type Information:
  [MINIMAL 46578b8e1954ec8f55c18e8a5800] (#deps: 0)
  [COMPLETE 74baedc00c9d1184e9ac93db73bc] (#deps: 0)
*/
#define TYPE_INFO_CDR_ThroughputModule_DataType (unsigned char []){ \
  0x60, 0x00, 0x00, 0x00, 0x01, 0x10, 0x00, 0x40, 0x28, 0x00, 0x00, 0x00, 0x24, 0x00, 0x00, 0x00, \
  0x14, 0x00, 0x00, 0x00, 0xf1, 0x46, 0x57, 0x8b, 0x8e, 0x19, 0x54, 0xec, 0x8f, 0x55, 0xc1, 0x8e, \
  0x8a, 0x58, 0x00, 0x00, 0x3c, 0x00, 0x00, 0x00, 0x00, 0x00, 0x00, 0x00, 0x04, 0x00, 0x00, 0x00, \
  0x00, 0x00, 0x00, 0x00, 0x02, 0x10, 0x00, 0x40, 0x28, 0x00, 0x00, 0x00, 0x24, 0x00, 0x00, 0x00, \
  0x14, 0x00, 0x00, 0x00, 0xf2, 0x74, 0xba, 0xed, 0xc0, 0x0c, 0x9d, 0x11, 0x84, 0xe9, 0xac, 0x93, \
  0xdb, 0x73, 0xbc, 0x00, 0x6e, 0x00, 0x00, 0x00, 0x00, 0x00, 0x00, 0x00, 0x04, 0x00, 0x00, 0x00, \
  0x00, 0x00, 0x00, 0x00\
}
#define TYPE_INFO_CDR_SZ_ThroughputModule_DataType 100u
#define TYPE_MAP_CDR_ThroughputModule_DataType (unsigned char []){ \
  0x50, 0x00, 0x00, 0x00, 0x01, 0x00, 0x00, 0x00, 0xf1, 0x46, 0x57, 0x8b, 0x8e, 0x19, 0x54, 0xec, \
  0x8f, 0x55, 0xc1, 0x8e, 0x8a, 0x58, 0x00, 0x00, 0x38, 0x00, 0x00, 0x00, 0xf1, 0x51, 0x01, 0x00, \
  0x01, 0x00, 0x00, 0x00, 0x00, 0x00, 0x00, 0x00, 0x28, 0x00, 0x00, 0x00, 0x02, 0x00, 0x00, 0x00, \
  0x0b, 0x00, 0x00, 0x00, 0x00, 0x00, 0x00, 0x00, 0x01, 0x00, 0x08, 0xe2, 0x94, 0x2a, 0x04, 0x00, \
  0x10, 0x00, 0x00, 0x00, 0x01, 0x00, 0x00, 0x00, 0x01, 0x00, 0x80, 0xf3, 0x01, 0x00, 0x00, 0x02, \
  0x32, 0x1c, 0x3c, 0xf4, 0x82, 0x00, 0x00, 0x00, 0x01, 0x00, 0x00, 0x00, 0xf2, 0x74, 0xba, 0xed, \
  0xc0, 0x0c, 0x9d, 0x11, 0x84, 0xe9, 0xac, 0x93, 0xdb, 0x73, 0xbc, 0x00, 0x6a, 0x00, 0x00, 0x00, \
  0xf2, 0x51, 0x01, 0x00, 0x23, 0x00, 0x00, 0x00, 0x00, 0x00, 0x00, 0x00, 0x1b, 0x00, 0x00, 0x00, \
  0x54, 0x68, 0x72, 0x6f, 0x75, 0x67, 0x68, 0x70, 0x75, 0x74, 0x4d, 0x6f, 0x64, 0x75, 0x6c, 0x65, \
  0x3a, 0x3a, 0x44, 0x61, 0x74, 0x61, 0x54, 0x79, 0x70, 0x65, 0x00, 0x00, 0x3a, 0x00, 0x00, 0x00, \
  0x02, 0x00, 0x00, 0x00, 0x14, 0x00, 0x00, 0x00, 0x00, 0x00, 0x00, 0x00, 0x01, 0x00, 0x08, 0x00, \
  0x06, 0x00, 0x00, 0x00, 0x63, 0x6f, 0x75, 0x6e, 0x74, 0x00, 0x00, 0x00, 0x1a, 0x00, 0x00, 0x00, \
  0x01, 0x00, 0x00, 0x00, 0x01, 0x00, 0x80, 0xf3, 0x01, 0x00, 0x00, 0x02, 0x08, 0x00, 0x00, 0x00, \
  0x70, 0x61, 0x79, 0x6c, 0x6f, 0x61, 0x64, 0x00, 0x00, 0x00, 0x00, 0x00, 0x22, 0x00, 0x00, 0x00, \
  0x01, 0x00, 0x00, 0x00, 0xf2, 0x74, 0xba, 0xed, 0xc0, 0x0c, 0x9d, 0x11, 0x84, 0xe9, 0xac, 0x93, \
  0xdb, 0x73, 0xbc, 0xf1, 0x46, 0x57, 0x8b, 0x8e, 0x19, 0x54, 0xec, 0x8f, 0x55, 0xc1, 0x8e, 0x8a, \
  0x58, 0x00\
}
#define TYPE_MAP_CDR_SZ_ThroughputModule_DataType 258u
const dds_topic_descriptor_t ThroughputModule_DataType_desc =
{
  .m_size = sizeof (ThroughputModule_DataType),
  .m_align = dds_alignof (ThroughputModule_DataType),
  .m_flagset = DDS_TOPIC_XTYPES_METADATA,
  .m_nkeys = 0u,
  .m_typename = "ThroughputModule::DataType",
  .m_keys = NULL,
  .m_nops = 3,
  .m_ops = ThroughputModule_DataType_ops,
  .m_meta = "",
  .type_information = { .data = TYPE_INFO_CDR_ThroughputModule_DataType, .sz = TYPE_INFO_CDR_SZ_ThroughputModule_DataType },
  .type_mapping = { .data = TYPE_MAP_CDR_ThroughputModule_DataType, .sz = TYPE_MAP_CDR_SZ_ThroughputModule_DataType }
};
```

## src/Throughput.h
```c
/****************************************************************

  Generated by Eclipse Cyclone DDS IDL to C Translator
  File name: /home/patrickm/zephyrproject/zephyr/samples/dds_hello_world/src/Throughput.h
  Source: /home/patrickm/zephyrproject/zephyr/samples/dds_hello_world/cyclonedds/examples/throughput/Throughput.idl
  Cyclone DDS: V0.11.0

*****************************************************************/
#ifndef DDSC__HOME_PATRICKM_ZEPHYRPROJECT_ZEPHYR_SAMPLES_DDS_HELLO_WORLD_SRC_THROUGHPUT_H
#define DDSC__HOME_PATRICKM_ZEPHYRPROJECT_ZEPHYR_SAMPLES_DDS_HELLO_WORLD_SRC_THROUGHPUT_H

#include "dds/ddsc/dds_public_impl.h"

#ifdef __cplusplus
extern "C" {
#endif

#ifndef DDS_SEQUENCE_OCTET_DEFINED
#define DDS_SEQUENCE_OCTET_DEFINED
typedef struct dds_sequence_octet
{
  uint32_t _maximum;
  uint32_t _length;
  uint8_t *_buffer;
  bool _release;
} dds_sequence_octet;

#define dds_sequence_octet__alloc() \
((dds_sequence_octet*) dds_alloc (sizeof (dds_sequence_octet)));

#define dds_sequence_octet_allocbuf(l) \
((uint8_t *) dds_alloc ((l) * sizeof (uint8_t)))
#endif /* DDS_SEQUENCE_OCTET_DEFINED */

typedef struct ThroughputModule_DataType
{
  uint64_t count;
  dds_sequence_octet payload;
} ThroughputModule_DataType;

extern const dds_topic_descriptor_t ThroughputModule_DataType_desc;

#define ThroughputModule_DataType__alloc() \
((ThroughputModule_DataType*) dds_alloc (sizeof (ThroughputModule_DataType)));

#define ThroughputModule_DataType_free(d,o) \
dds_sample_free ((d), &ThroughputModule_DataType_desc, (o))

#ifdef __cplusplus
}
#endif

#endif /* DDSC__HOME_PATRICKM_ZEPHYRPROJECT_ZEPHYR_SAMPLES_DDS_HELLO_WORLD_SRC_THROUGHPUT_H */
```

## src/ddsperf_types.h
```c
/****************************************************************

  Generated by Eclipse Cyclone DDS IDL to C Translator
  File name: /home/patrickm/zephyrproject/zephyr/samples/dds_hello_world/src/ddsperf_types.h
  Source: /home/patrickm/zephyrproject/zephyr/samples/dds_hello_world/cyclonedds/src/tools/ddsperf/ddsperf_types.idl
  Cyclone DDS: V0.11.0

*****************************************************************/
#ifndef DDSC__HOME_PATRICKM_ZEPHYRPROJECT_ZEPHYR_SAMPLES_DDS_HELLO_WORLD_SRC_DDSPERF_TYPES_H
#define DDSC__HOME_PATRICKM_ZEPHYRPROJECT_ZEPHYR_SAMPLES_DDS_HELLO_WORLD_SRC_DDSPERF_TYPES_H

#include "dds/ddsc/dds_public_impl.h"

#ifdef __cplusplus
extern "C" {
#endif

typedef struct OneULong
{
  uint32_t seq;
} OneULong;

extern const dds_topic_descriptor_t OneULong_desc;

#define OneULong__alloc() \
((OneULong*) dds_alloc (sizeof (OneULong)));

#define OneULong_free(d,o) \
dds_sample_free ((d), &OneULong_desc, (o))

typedef struct Unkeyed16
{
  uint32_t seq;
  uint8_t baggage[12];
} Unkeyed16;

extern const dds_topic_descriptor_t Unkeyed16_desc;

#define Unkeyed16__alloc() \
((Unkeyed16*) dds_alloc (sizeof (Unkeyed16)));

#define Unkeyed16_free(d,o) \
dds_sample_free ((d), &Unkeyed16_desc, (o))

typedef struct Unkeyed1024
{
  uint32_t seq;
  uint8_t baggage[1020];
} Unkeyed1024;

extern const dds_topic_descriptor_t Unkeyed1024_desc;

#define Unkeyed1024__alloc() \
((Unkeyed1024*) dds_alloc (sizeof (Unkeyed1024)));

#define Unkeyed1024_free(d,o) \
dds_sample_free ((d), &Unkeyed1024_desc, (o))

typedef struct Keyed32
{
  uint32_t seq;
  uint32_t keyval;
  uint8_t baggage[24];
} Keyed32;

extern const dds_topic_descriptor_t Keyed32_desc;

#define Keyed32__alloc() \
((Keyed32*) dds_alloc (sizeof (Keyed32)));

#define Keyed32_free(d,o) \
dds_sample_free ((d), &Keyed32_desc, (o))

typedef struct Keyed256
{
  uint32_t seq;
  uint32_t keyval;
  uint8_t baggage[248];
} Keyed256;

extern const dds_topic_descriptor_t Keyed256_desc;

#define Keyed256__alloc() \
((Keyed256*) dds_alloc (sizeof (Keyed256)));

#define Keyed256_free(d,o) \
dds_sample_free ((d), &Keyed256_desc, (o))

#ifndef DDS_SEQUENCE_OCTET_DEFINED
#define DDS_SEQUENCE_OCTET_DEFINED
typedef struct dds_sequence_octet
{
  uint32_t _maximum;
  uint32_t _length;
  uint8_t *_buffer;
  bool _release;
} dds_sequence_octet;

#define dds_sequence_octet__alloc() \
((dds_sequence_octet*) dds_alloc (sizeof (dds_sequence_octet)));

#define dds_sequence_octet_allocbuf(l) \
((uint8_t *) dds_alloc ((l) * sizeof (uint8_t)))
#endif /* DDS_SEQUENCE_OCTET_DEFINED */

typedef struct KeyedSeq
{
  uint32_t seq;
  uint32_t keyval;
  dds_sequence_octet baggage;
} KeyedSeq;

extern const dds_topic_descriptor_t KeyedSeq_desc;

#define KeyedSeq__alloc() \
((KeyedSeq*) dds_alloc (sizeof (KeyedSeq)));

#define KeyedSeq_free(d,o) \
dds_sample_free ((d), &KeyedSeq_desc, (o))

typedef struct CPUStatThread
{
  char * name;
  int32_t u_pct;
  int32_t s_pct;
} CPUStatThread;

#ifndef DDS_SEQUENCE_CPUSTATTHREAD_DEFINED
#define DDS_SEQUENCE_CPUSTATTHREAD_DEFINED
typedef struct dds_sequence_CPUStatThread
{
  uint32_t _maximum;
  uint32_t _length;
  struct CPUStatThread *_buffer;
  bool _release;
} dds_sequence_CPUStatThread;

#define dds_sequence_CPUStatThread__alloc() \
((dds_sequence_CPUStatThread*) dds_alloc (sizeof (dds_sequence_CPUStatThread)));

#define dds_sequence_CPUStatThread_allocbuf(l) \
((struct CPUStatThread *) dds_alloc ((l) * sizeof (struct CPUStatThread)))
#endif /* DDS_SEQUENCE_CPUSTATTHREAD_DEFINED */

typedef struct CPUStats
{
  char * hostname;
  uint32_t pid;
  double maxrss;
  uint32_t vcsw;
  uint32_t ivcsw;
  bool some_above;
  dds_sequence_CPUStatThread cpu;
} CPUStats;

extern const dds_topic_descriptor_t CPUStats_desc;

#define CPUStats__alloc() \
((CPUStats*) dds_alloc (sizeof (CPUStats)));

#define CPUStats_free(d,o) \
dds_sample_free ((d), &CPUStats_desc, (o))

typedef struct Struct16
{
  uint8_t struct0;
  uint8_t struct1;
  uint8_t struct2;
  uint8_t struct3;
  uint8_t struct4;
  uint8_t struct5;
  uint8_t struct6;
  uint8_t struct7;
  uint8_t struct8;
  uint8_t struct9;
  uint8_t structa;
  uint8_t structb;
  uint8_t structc;
  uint8_t structd;
  uint8_t structe;
  uint8_t structf;
  int64_t junk;
  uint32_t seq;
  uint32_t keyval;
} Struct16;

extern const dds_topic_descriptor_t Struct16_desc;

#define Struct16__alloc() \
((Struct16*) dds_alloc (sizeof (Struct16)));

#define Struct16_free(d,o) \
dds_sample_free ((d), &Struct16_desc, (o))

typedef struct Struct256
{
  struct Struct16 struct160;
  struct Struct16 struct161;
  struct Struct16 struct162;
  struct Struct16 struct163;
  struct Struct16 struct164;
  struct Struct16 struct165;
  struct Struct16 struct166;
  struct Struct16 struct167;
  struct Struct16 struct168;
  struct Struct16 struct169;
  struct Struct16 struct16a;
  struct Struct16 struct16b;
  struct Struct16 struct16c;
  struct Struct16 struct16d;
  struct Struct16 struct16e;
  struct Struct16 struct16f;
  int64_t junk;
  uint32_t seq;
  uint32_t keyval;
} Struct256;

extern const dds_topic_descriptor_t Struct256_desc;

#define Struct256__alloc() \
((Struct256*) dds_alloc (sizeof (Struct256)));

#define Struct256_free(d,o) \
dds_sample_free ((d), &Struct256_desc, (o))

typedef struct Struct4k
{
  struct Struct256 struct2560;
  struct Struct256 struct2561;
  struct Struct256 struct2562;
  struct Struct256 struct2563;
  struct Struct256 struct2564;
  struct Struct256 struct2565;
  struct Struct256 struct2566;
  struct Struct256 struct2567;
  struct Struct256 struct2568;
  struct Struct256 struct2569;
  struct Struct256 struct256a;
  struct Struct256 struct256b;
  struct Struct256 struct256c;
  struct Struct256 struct256d;
  struct Struct256 struct256e;
  struct Struct256 struct256f;
  int64_t junk;
  uint32_t seq;
  uint32_t keyval;
} Struct4k;

extern const dds_topic_descriptor_t Struct4k_desc;

#define Struct4k__alloc() \
((Struct4k*) dds_alloc (sizeof (Struct4k)));

#define Struct4k_free(d,o) \
dds_sample_free ((d), &Struct4k_desc, (o))

typedef struct Struct32k
{
  struct Struct4k struct4k0;
  struct Struct4k struct4k1;
  struct Struct4k struct4k2;
  struct Struct4k struct4k3;
  struct Struct4k struct4k4;
  struct Struct4k struct4k5;
  struct Struct4k struct4k6;
  struct Struct4k struct4k7;
  int64_t junk;
  uint32_t seq;
  uint32_t keyval;
} Struct32k;

extern const dds_topic_descriptor_t Struct32k_desc;

#define Struct32k__alloc() \
((Struct32k*) dds_alloc (sizeof (Struct32k)));

#define Struct32k_free(d,o) \
dds_sample_free ((d), &Struct32k_desc, (o))

#ifdef __cplusplus
}
#endif

#endif /* DDSC__HOME_PATRICKM_ZEPHYRPROJECT_ZEPHYR_SAMPLES_DDS_HELLO_WORLD_SRC_DDSPERF_TYPES_H */
```

## src/pong.c
```c
#include "dds/dds.h"
#include "dds/ddsrt/misc.h"
#include "RoundTrip.h"
#include <stdio.h>
#include <stdlib.h>
#include <string.h>
#include <signal.h>
#include <stdlib.h>

static dds_entity_t waitSet;
#define MAX_SAMPLES 10

/* Forward declarations */
static dds_entity_t prepare_dds(dds_entity_t *writer, dds_entity_t *reader, dds_entity_t *readCond, dds_listener_t *listener);
static void finalize_dds(dds_entity_t participant, RoundTripModule_DataType data[MAX_SAMPLES]);

#ifdef _WIN32
#include <Windows.h>
static bool CtrlHandler (DWORD fdwCtrlType)
{
  (void)fdwCtrlType;
  dds_waitset_set_trigger (waitSet, true);
  return true; //Don't let other handlers handle this key
}
#elif !DDSRT_WITH_FREERTOS && !__ZEPHYR__
static void CtrlHandler (int sig)
{
  (void)sig;
  dds_waitset_set_trigger (waitSet, true);
}
#endif

static RoundTripModule_DataType data[MAX_SAMPLES];
static void * samples[MAX_SAMPLES];
static dds_sample_info_t info[MAX_SAMPLES];

static dds_entity_t participant;
static dds_entity_t reader;
static dds_entity_t writer;
static dds_entity_t readCond;

static void data_available(dds_entity_t rd, void *arg)
{
  int status, samplecount;
  (void)arg;
  samplecount = dds_take (rd, samples, info, MAX_SAMPLES, MAX_SAMPLES);
  if (samplecount < 0)
    DDS_FATAL("dds_take: %s\n", dds_strretcode(-samplecount));
  for (int j = 0; !dds_triggered (waitSet) && j < samplecount; j++)
  {
    /* If instance has been disposed terminate pong */

    if (info[j].instance_state == DDS_IST_NOT_ALIVE_DISPOSED)
    {
      printf ("Received termination request. Terminating.\n");
      dds_waitset_set_trigger (waitSet, true);
      break;
    }
    else if (info[j].valid_data)
    {
      /* If sample is valid, send it back to ping */
      RoundTripModule_DataType * valid_sample = &data[j];
      status = dds_write_ts (writer, valid_sample, info[j].source_timestamp);
      if (status < 0)
        DDS_FATAL("dds_write_ts: %d\n", -status);
    }
  }
}

int roundtrip_pong (int argc, char *argv[])
{
  dds_duration_t waitTimeout = DDS_INFINITY;
  unsigned int i;
  int status;
  dds_attach_t wsresults[1];
  size_t wsresultsize = 1U;

  dds_listener_t *listener = NULL;
  bool use_listener = false;
  int argidx = 1;

  if (argc > argidx && strcmp(argv[argidx], "-l") == 0)
  {
    argidx++;
    use_listener = true;
  }

  /* Register handler for Ctrl-C */

#ifdef _WIN32
  DDSRT_WARNING_GNUC_OFF(cast-function-type)
  SetConsoleCtrlHandler ((PHANDLER_ROUTINE)CtrlHandler, TRUE);
  DDSRT_WARNING_GNUC_ON(cast-function-type)
#elif !DDSRT_WITH_FREERTOS && !__ZEPHYR__
  struct sigaction sat, oldAction;
  sat.sa_handler = CtrlHandler;
  sigemptyset (&sat.sa_mask);
  sat.sa_flags = 0;
  sigaction (SIGINT, &sat, &oldAction);
#endif

  /* Initialize sample data */
  memset (data, 0, sizeof (data));
  for (i = 0; i < MAX_SAMPLES; i++)
  {
    samples[i] = &data[i];
  }

  participant = dds_create_participant (DDS_DOMAIN_DEFAULT, NULL, NULL);
  if (participant < 0)
    DDS_FATAL("dds_create_participant: %s\n", dds_strretcode(-participant));

  if (use_listener)
  {
    listener = dds_create_listener(NULL);
    dds_lset_data_available(listener, data_available);
  }

  (void)prepare_dds(&writer, &reader, &readCond, listener);

  while (!dds_triggered (waitSet))
  {
    /* Wait for a sample from ping */

    status = dds_waitset_wait (waitSet, wsresults, wsresultsize, waitTimeout);
    if (status < 0)
      DDS_FATAL("dds_waitset_wait: %s\n", dds_strretcode(-status));

    /* Take samples */
    if (listener == NULL) {
      data_available (reader, 0);
    }
  }

#ifdef _WIN32
  SetConsoleCtrlHandler (0, FALSE);
#elif !DDSRT_WITH_FREERTOS && !__ZEPHYR__
  sigaction (SIGINT, &oldAction, 0);
#endif

  /* Clean up */
  finalize_dds(participant, data);

  return EXIT_SUCCESS;
}

static void finalize_dds(dds_entity_t pp, RoundTripModule_DataType xs[MAX_SAMPLES])
{
  dds_return_t status;
  status = dds_delete (pp);
  if (status < 0)
    DDS_FATAL("dds_delete: %s\n", dds_strretcode(-status));
  for (unsigned int i = 0; i < MAX_SAMPLES; i++)
  {
    RoundTripModule_DataType_free (&xs[i], DDS_FREE_CONTENTS);
  }
}

static dds_entity_t prepare_dds(dds_entity_t *wr, dds_entity_t *rd, dds_entity_t *rdcond, dds_listener_t *rdlist)
{
  const char *pubPartitions[] = { "pong" };
  const char *subPartitions[] = { "ping" };
  dds_qos_t *qos;
  dds_entity_t subscriber;
  dds_entity_t publisher;
  dds_entity_t topic;
  dds_return_t status;

  /* A DDS Topic is created for our sample type on the domain participant. */

  qos = dds_create_qos ();
  dds_qset_reliability (qos, DDS_RELIABILITY_RELIABLE, DDS_SECS(10));
  topic = dds_create_topic (participant, &RoundTripModule_DataType_desc, "RoundTrip", qos, NULL);
  if (topic < 0)
    DDS_FATAL("dds_create_topic: %s\n", dds_strretcode(-topic));
  dds_delete_qos (qos);

  /* A DDS Publisher is created on the domain participant. */

  qos = dds_create_qos ();
  dds_qset_partition (qos, 1, pubPartitions);

  publisher = dds_create_publisher (participant, qos, NULL);
  if (publisher < 0)
    DDS_FATAL("dds_create_publisher: %s\n", dds_strretcode(-publisher));
  dds_delete_qos (qos);

  /* A DDS DataWriter is created on the Publisher & Topic with a modififed Qos. */

  qos = dds_create_qos ();
  dds_qset_writer_data_lifecycle (qos, false);
  *wr = dds_create_writer (publisher, topic, qos, NULL);
  if (*wr < 0)
    DDS_FATAL("dds_create_writer: %s\n", dds_strretcode(-*wr));
  dds_delete_qos (qos);

  /* A DDS Subscriber is created on the domain participant. */

  qos = dds_create_qos ();
  dds_qset_partition (qos, 1, subPartitions);

  subscriber = dds_create_subscriber (participant, qos, NULL);
  if (subscriber < 0)
    DDS_FATAL("dds_create_subscriber: %s\n", dds_strretcode(-subscriber));
  dds_delete_qos (qos);

  /* A DDS DataReader is created on the Subscriber & Topic with a modified QoS. */

  *rd = dds_create_reader (subscriber, topic, NULL, rdlist);
  if (*rd < 0)
    DDS_FATAL("dds_create_reader: %s\n", dds_strretcode(-*rd));

  waitSet = dds_create_waitset (participant);
  if (rdlist == NULL) {
    *rdcond = dds_create_readcondition (*rd, DDS_ANY_STATE);
    status = dds_waitset_attach (waitSet, *rdcond, *rd);
    if (status < 0)
      DDS_FATAL("dds_waitset_attach: %s\n", dds_strretcode(-status));
  } else {
    *rdcond = 0;
  }
  status = dds_waitset_attach (waitSet, waitSet, waitSet);
  if (status < 0)
    DDS_FATAL("dds_waitset_attach: %s\n", dds_strretcode(-status));

  printf ("Waiting for samples from ping to send back...\n");
  fflush (stdout);

  return participant;
}
```
